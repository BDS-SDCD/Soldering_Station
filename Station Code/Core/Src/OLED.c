#include "OLED.h"


uint16_t CharMass[]={0x00, 0x00, 0x00, 0x00, 0x00, 0x00,   // sp
		0x00, 0x00, 0x00, 0x2f, 0x00, 0x00,   // !
		0x00, 0x00, 0x07, 0x00, 0x07, 0x00,   // "
		0x00, 0x14, 0x7f, 0x14, 0x7f, 0x14,   // #
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		0x00, 0x00, 0x06, 0x09, 0x09, 0x06    // ~ (Degrees)
};
//----------------------------------------------------------------------------
uint8_t Bufer[129]={0};
//----------------------------------------------------------------------------
void OLED_Send_Comand(struct OLED * self,uint8_t comand){
	uint8_t Local_Bufer[1]={0};
	Local_Bufer[0]=OLED_Comand_Buffer;
	Local_Bufer[1]=comand;
	HAL_I2C_Master_Transmit(self->hi2c,self->Adress,(uint8_t *)&Local_Bufer,(uint16_t)2,1000);
}
//----------------------------------------------------------------------------
void OLED_ON(uint8_t stend){


}
//----------------------------------------------------------------------------
void OLED_Search_Adress(struct OLED * self){
	for(int i=0;i<256;i++){
			if(HAL_I2C_IsDeviceReady((self->hi2c),i,10,2)==HAL_OK){
				self->Adress=i;
				break;
			}
		}
}
//----------------------------------------------------------------------------

void OLED_ini(struct OLED * self){



	OLED_Send_Comand(self,0xAF);		//Display on/off

	OLED_Send_Comand(self,0xA6);		//Normal/inverse color mode

	OLED_Send_Comand(self,0x20);		//Set page address mode
	OLED_Send_Comand(self,0x0);

	OLED_Send_Comand(self,0x8d);		//Pump Charge

	OLED_Send_Comand(self,0xA4);		//Entire display on (output flows/ignore ram)

	OLED_Send_Comand(self,0xA0);		//Segment re-map

	OLED_Send_Comand(self,0xC7);		//Com output right direction/inverse direction

	OLED_Send_Comand(self,0x21);     //Set COM remap value
	OLED_Send_Comand(self,0x0);
	OLED_Send_Comand(self,0x7D);

	OLED_Send_Comand(self,0x22);
	OLED_Send_Comand(self,0x0);
	OLED_Send_Comand(self,0x7);

	OLED_Clear_Display(self);

}
//----------------------------------------------------------------------------

void OLED_Set_Cursor(struct OLED * self,uint16_t x,uint8_t y){
	OLED_Send_Comand(self,0xB0|y);
	OLED_Send_Comand(self,x & 0x0F);
	OLED_Send_Comand(self,((x>>4) & 0x0F)+0x10);


}
//----------------------------------------------------------------------------
void OLED_Set_Char_Cursor(struct OLED * self, uint16_t x,uint8_t y){
	x*=6;
	OLED_Send_Comand(self,0xB0|y);
	OLED_Send_Comand(self,x & 0x0F);
	OLED_Send_Comand(self,((x>>4) & 0x0F)+0x10);


}
//----------------------------------------------------------------------------
void OLED_Clear_Display(struct OLED * self){
	Bufer[0]=OLED_Data_Buffer;
	for(uint8_t j=0;j<8;j++){
		OLED_Set_Cursor(self,0,j);
		HAL_I2C_Master_Transmit(self->hi2c,self->Adress,(uint8_t *)&Bufer,(uint16_t)129,1000);
		}
}
//----------------------------------------------------------------------------
void OLED_Send_Char(struct OLED * self, uint8_t data){
	uint8_t Local_Bufer[7]={0};
	Local_Bufer[0]=OLED_Data_Buffer;
	int sp=(data-(int)' ')*6;
	for(int j=1;j<7;j++)
		Local_Bufer[j]=CharMass[sp+j-1];

	HAL_I2C_Master_Transmit(self->hi2c,self->Adress,(uint8_t *)&Local_Bufer,(uint16_t)7,1000);

}
//----------------------------------------------------------------------------
void OLED_Clear_Char(struct OLED * self,uint16_t x, uint8_t y){
	OLED_Set_Char_Cursor(self,x, y);
	OLED_Send_Char(self,' ');
}
//----------------------------------------------------------------------------
void OLED_Clear_Line (struct OLED * self, uint8_t y){
	OLED_Set_Cursor(self,0,y);
	HAL_I2C_Master_Transmit(self->hi2c,self->Adress,(uint8_t *)&Bufer,(uint16_t)129,1000);
}
//----------------------------------------------------------------------------
void OLED_Send_String(struct OLED * self,char* str){

	uint8_t Local_Bufer[127]={0};
	Local_Bufer[0]=OLED_Data_Buffer;

	int i=0,sp,counter=0;
	uint8_t j,colum=0;
	while(str[i]!='\0'){
		if(str[i]=='\r'||str[i]=='\n'){
			i++;
			continue;
		}

		sp=(str[i]-(int)' ')*6;
		for(j=0;j<6;j++)
			Local_Bufer[(j+counter*6)+1]=CharMass[sp+j];

		i++;
		counter++;

		if(counter>20){
			 OLED_Set_Cursor(self,0,colum);
			HAL_I2C_Master_Transmit(self->hi2c,self->Adress,(uint8_t *)&Local_Bufer,(uint16_t)(counter*6)+1,1000);
			colum++;
			counter=0;

		}
	}

	HAL_I2C_Master_Transmit(self->hi2c,self->Adress,(uint8_t *)&Local_Bufer,(uint16_t)(counter*6)+1,1000);


}
//----------------------------------------------------------------------------

